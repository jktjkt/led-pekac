## fw/configs/raspberrypi0w_pekac_defconfig
```kconfig
BR2_arm=y
BR2_arm1176jzf_s=y
BR2_GLOBAL_PATCH_DIR="$(BR2_EXTERNAL_HRZTV_PATH)/board/pi/patches"
BR2_PER_PACKAGE_DIRECTORIES=y
BR2_TOOLCHAIN_EXTERNAL=y
BR2_TARGET_GENERIC_HOSTNAME=""
BR2_TARGET_GENERIC_ISSUE=""
BR2_INIT_SYSTEMD=y
BR2_ROOTFS_DEVICE_TABLE="system/device_table.txt $(BR2_EXTERNAL_HRZTV_PATH)/board/pi/permissions.table"
BR2_TARGET_GENERIC_GETTY_PORT="ttyS0"
# BR2_TARGET_GENERIC_REMOUNT_ROOTFS_RW is not set
BR2_SYSTEM_DEFAULT_PATH="/bin:/sbin:/usr/bin:/usr/sbin"
BR2_ROOTFS_OVERLAY="$(BR2_EXTERNAL_HRZTV_PATH)/board/pi/overlay"
BR2_ROOTFS_POST_BUILD_SCRIPT="board/raspberrypi0w/post-build.sh"
BR2_ROOTFS_POST_IMAGE_SCRIPT="$(BR2_EXTERNAL_HRZTV_PATH)/board/pi/post-image.sh"
BR2_LINUX_KERNEL=y
BR2_LINUX_KERNEL_CUSTOM_TARBALL=y
BR2_LINUX_KERNEL_CUSTOM_TARBALL_LOCATION="$(call github,raspberrypi,linux,6495fa3396fb387d3871ced42a30281fe7be5352)/linux-6495fa3396fb387d3871ced42a30281fe7be5352.tar.gz"
BR2_LINUX_KERNEL_DEFCONFIG="bcmrpi"
BR2_LINUX_KERNEL_CONFIG_FRAGMENT_FILES="$(BR2_EXTERNAL_HRZTV_PATH)/board/pi/linux.fragment"
BR2_LINUX_KERNEL_DTS_SUPPORT=y
BR2_LINUX_KERNEL_INTREE_DTS_NAME="bcm2708-rpi-zero-w"
BR2_LINUX_KERNEL_CUSTOM_DTS_PATH="$(BR2_EXTERNAL_HRZTV_PATH)/board/pi/tally.dts"
BR2_LINUX_KERNEL_NEEDS_HOST_OPENSSL=y
BR2_PACKAGE_LINUX_TOOLS_CPUPOWER=y
BR2_PACKAGE_LINUX_TOOLS_GPIO=y
BR2_PACKAGE_LINUX_TOOLS_PERF=y
BR2_PACKAGE_LINUX_TOOLS_PERF_TUI=y
BR2_PACKAGE_LINUX_TOOLS_TMON=y
BR2_PACKAGE_STRACE=y
BR2_PACKAGE_RPI_BT_FIRMWARE=y
BR2_PACKAGE_RPI_FIRMWARE=y
BR2_PACKAGE_RPI_FIRMWARE_INSTALL_VCDBG=y
BR2_PACKAGE_RPI_WIFI_FIRMWARE=y
BR2_PACKAGE_EVTEST=y
BR2_PACKAGE_RNG_TOOLS=y
BR2_PACKAGE_PYTHON3=y
BR2_PACKAGE_PYTHON3_PY_PYC=y
BR2_PACKAGE_READLINE=y
BR2_PACKAGE_CRDA=y
BR2_PACKAGE_IPROUTE2=y
BR2_PACKAGE_IPUTILS=y
# BR2_PACKAGE_IPUTILS_RDISC is not set
# BR2_PACKAGE_IPUTILS_NINFOD is not set
BR2_PACKAGE_IW=y
BR2_PACKAGE_IWD=y
BR2_PACKAGE_OPENSSH=y
BR2_PACKAGE_TCPDUMP=y
BR2_PACKAGE_WIREGUARD_TOOLS=y
BR2_PACKAGE_SYSTEMD_ANALYZE=y
BR2_TARGET_ROOTFS_EXT2=y
BR2_TARGET_ROOTFS_EXT2_4=y
BR2_TARGET_ROOTFS_EXT2_SIZE="250M"
# BR2_TARGET_ROOTFS_TAR is not set
BR2_PACKAGE_HOST_DOSFSTOOLS=y
BR2_PACKAGE_HOST_DTC=y
BR2_PACKAGE_HOST_GENIMAGE=y
BR2_PACKAGE_HOST_MTOOLS=y
BR2_PACKAGE_HOST_RASPBERRYPI_USBBOOT=y
BR2_PACKAGE_EOS_REMOTE_TALLY=y
```

## fw/package/eos-remote-tally/Config.in
```kconfig
config BR2_PACKAGE_EOS_REMOTE_TALLY
	bool "eos-remote-tally"
	select BR2_PACKAGE_PYTHON_ASYNCIO_MQTT
	select BR2_PACKAGE_LIBGPHOTO2
	select BR2_PACKAGE_PYTHON_GPHOTO2
	select BR2_PACKAGE_PYTHON_SMBUS_CFFI
	help
	  Tally LED light and remote camera control over MQTT

if BR2_PACKAGE_EOS_REMOTE_TALLY
config EOS_REMOTE_TALLY_MQTT_SERVER
	string "server address"
	help
	  Address of the MQTT server that the cameras should connect to
endif
```
